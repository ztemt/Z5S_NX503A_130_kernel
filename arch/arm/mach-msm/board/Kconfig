## arch/arm/mach-msm/board/Kconfig
```kconfig
choice
	depends on ARCH_MSM8974
	prompt "MSM8974_MTP Based Board"

config ARCH_MSM8974_ORIG
	bool "Original ARCH_MSM8974"
	help
	  Support for Qualcomm MSM8974 MTP original eval board.

config BOARD_ZTEMT_NUBIA
	bool "ZTEMT NUBIA"
	help
	  Support for the ZTEMT NUBIA board.

endchoice

config ZTEMT_RESTART
	bool "ZTEMT restart"
	help
	  Support for the ZTEMT restart

config ZTEMT_UART
	bool "ZTEMT uart"
	help
	  Support for the ZTEMT board uart.

config EMMC_UNSUPPORTED_HPI
	bool "ZTEMT emmc unsupported hpi feature"
	help
	  emmc unsupported hpi feature.
```

## drivers/video/msm/mdss/Kconfig
```kconfig
config FB_MSM_MDSS_WRITEBACK
	bool "MDSS Writeback Panel"
	---help---
	The MDSS Writeback Panel provides support for routing the output of
	MDSS frame buffer driver and MDP processing to memory.

config FB_MSM_MDSS_HDMI_PANEL
	depends on FB_MSM_MDSS
	bool "MDSS HDMI Tx Panel"
	default n
	---help---
	The MDSS HDMI Panel provides support for transmitting TMDS signals of
	MDSS frame buffer data to connected hdmi compliant TVs, monitors etc.

config FB_MSM_MDSS_HDMI_MHL_SII8334
	depends on FB_MSM_MDSS_HDMI_PANEL
	bool 'MHL SII8334 support '
	default n
	---help---
	  Support the HDMI to MHL conversion.
	  MHL (Mobile High-Definition Link) technology
	  uses USB connector to output HDMI content
#mayu 2012.12.19
menu "ZTEMT lcd driver support"
config ZTEMT_LCD_MIPI_COMMON
	bool "ztemt lcd MIPI interface driver module"
	default n
config ZTEMT_LCD_IOVDD_CONTRL_BY_LDO
	bool "ztemt lcd IOVDD contrl by ldo"
	depends on ZTEMT_LCD_MIPI_COMMON
	default n
config ZTEMT_LCD_AVDD_NEGATIVE_CONTRL
	bool "ztemt lcd AVDD negative contrl"
	depends on ZTEMT_LCD_MIPI_COMMON
	default n
config ZTEMT_LCD_AVDD_CONFIG_BY_TPS65132
	bool "ztemt lcd AVDD config by tps65132"
	depends on ZTEMT_LCD_MIPI_COMMON
	default n
config ZTEMT_MIPI_1080P_R63311_SHARP_IPS
	bool "MIPI 1080P R63311 SHARP IPS as default lcd"
	depends on ZTEMT_LCD_MIPI_COMMON
	default n
config ZTEMT_LCD_DISP_ENHANCE
	bool "LCD disp color enhance"
	depends on ZTEMT_LCD_MIPI_COMMON
	default n
config ZTEMT_LCD_DEBUG_EN
	bool "LCD debug log enable"
	depends on ZTEMT_LCD_MIPI_COMMON
	default n
endmenu
source "drivers/video/msm/mdss/slimport_anx7808/Kconfig"
```
